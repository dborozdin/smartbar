#include <avr/sleep.h>
#include <avr/power.h>
#include <avr/interrupt.h>
#include <avr/wdt.h>
#include "U8glib.h"

static unsigned char u8g_logo_bits[] U8G_PROGMEM = {

        0x00,0x00,0x00,0x00,0x00,0x00,0x00,0x00,0x00,0x00,0x00,0x00,0x00,0x00,0x00,0x00,

        0x00,0x00,0x00,0x00,0x00,0x00,0x00,0xFC,0x7F,0x00,0x00,0x00,0x00,0x00,0x00,0x00,
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        0x00,0x00,0x00,0x00,0x00,0x00,0x00,0x00,0x00,0x00,0x00,0x00,0x00,0x00,0x00,0x00};


const int sensorPowerPin = 7;
const int sensorPin = 8;
const int buttonPin = 2; //PB0 is INT0 pin
const int statusLED = 9;
const int tonePin= 1;

volatile int interrupt_count = -1;
volatile int wakeup_no_activity_count = 0;
volatile boolean bLongSleep= false;
const int no_activity_cycles_before_sleep=200;

const int oledPin1= 3;
const int oledPin2= 4;
const int oledPin3= 6;
const int oledPin4= 5;
const int oledPinFake= 20;

U8GLIB_SSD1306_128X64 u8g( oledPin1, oledPin2, oledPinFake, oledPin3, oledPin4);
#define u8g_logo_width 128
#define u8g_logo_height 64


ISR(INT0_vect)
{
    wakeupByButton();
}

void goToLongSleep()
{
    //turn display off
    digitalWrite (oledPin1, LOW); 
    digitalWrite (oledPin2, LOW); 
    digitalWrite (oledPin3, LOW); 
    digitalWrite (oledPin4, LOW); 
    bLongSleep= true;
    sleep();
}

ISR(WDT_vect)
{
    wakeup_no_activity_count++;
    WDTCSR &= ~(1<<WDE);
    WDTCSR &= ~(1<<WDIE);
    if(wakeup_no_activity_count >= no_activity_cycles_before_sleep)
    {
       goToLongSleep();
    }

}

ISR(WDT_OVERFLOW_vect)
{
    /*
    * Set wdt to generate interrupt
    * (Reset to 0 on each interrupt)
    */
    WDTCSR |= _BV(WDIE);

}

void setup() 
{
  
    DDRD &= ~(1 << DDD2);     // Clear the PD2 pin
    // PD2 (PCINT0 pin) is now an input
  
    PORTD |= (1 << PORTD2);    // turn On the Pull-up
    // PD2 is now an input with pull-up enabled
  
    EICRA |= (1 << ISC11);    // set INT0 to trigger on RISING
    EIMSK |= (1 << INT0);     // Turns on INT0
    
    pinMode(tonePin, INPUT);
    digitalWrite (tonePin, LOW);
    pinMode(sensorPin, INPUT);
    pinMode(sensorPowerPin, OUTPUT);
    digitalWrite (sensorPowerPin, HIGH);
    digitalWrite (sensorPin, LOW);
    
    interrupt_count=-1;
    drawOnDisplay();

 
}

void drawLogo(void) {
  // graphic commands to redraw the complete screen should be placed here  
    u8g.drawXBMP( 0, 0, u8g_logo_width, u8g_logo_height, u8g_logo_bits);
  
}

void wakeupByButton()
{
   wakeUpSystem();
   interrupt_count=0;
  
   if(bLongSleep==true)
   {
       //turn display on
       digitalWrite (oledPin1, HIGH); 
       digitalWrite (oledPin2, HIGH); 
       digitalWrite (oledPin3, HIGH); 
       digitalWrite (oledPin4, HIGH); 
       u8g.begin();
       bLongSleep= false;
   }
   //reset timer interrupts before sleep
   wakeup_no_activity_count= 0;
   drawOnDisplay();
  
}

void adjustWDT()
{
    
    /* Clear the reset flag. */
    MCUSR &= ~(1<<WDRF);
    
    /* In order to change WDE or the prescaler, we need to
     * set WDCE (This will allow updates for 4 clock cycles).
     */
    WDTCSR |= (1<<WDCE) | (1<<WDE);
  
    /* set new watchdog timeout prescaler value */
    WDTCSR =(0 << WDP3) | (0 << WDP2) | (1 << WDP1) | (1 << WDP0);//0,120 s
    
    /* Enable the WD interrupt (note no reset). */
    WDTCSR |= _BV(WDIE);

}

void sleep()
{
    cli(); // Disable interrupts
  
    digitalWrite(sensorPin, LOW); //use the internal pullup resistor
    digitalWrite(sensorPowerPin, LOW); 
    digitalWrite (statusLED, LOW);
    pinMode(statusLED, INPUT);
    pinMode(sensorPowerPin, INPUT);
    pinMode(tonePin, INPUT);
    
    if(bLongSleep==false)
    {
        adjustWDT();
    }
    
    MCUCR = bit (BODS) | bit (BODSE);  // turn on brown-out enable select
    MCUCR = bit (BODS);        // this must be done within 4 clock cycles of above
    ADCSRA &= ~_BV(ADEN); // ADC off
  
    set_sleep_mode(SLEEP_MODE_PWR_DOWN);   // sleep mode is set here
  
    sleep_enable(); // Sets the Sleep Enable bit in the MCUCR Register (SE BIT)
  
    sei(); // Enable interrupts
    
  
    sleep_cpu(); // SLEEP
    
    // Restart the watchdog
    wdt_reset();

    wakeUpSystem();
 

}

void wakeUpSystem()
{
    cli(); // Disable interrupts
    
    sleep_disable(); // Clear SE bit
    ADCSRA |= _BV(ADEN); // ADC on
    
    sei(); // Enable interrupts
}

void draw(int cnt) 
{

    u8g.setFont(u8g_font_fub49n);
    u8g.setFontPosTop();
    
    char str_cnt[20]= ""; 
    sprintf (str_cnt, "%i", cnt);
    int w = u8g.getStrWidth(str_cnt);
    u8g.drawStr( 64- w/2, (64-49)/2, str_cnt);


}

void drawOnDisplay()
{
  if(interrupt_count<0)
  {
      u8g.firstPage();  
      do {
      } while( u8g.nextPage() );
      u8g.firstPage();  
      do {
          drawLogo();
      } while( u8g.nextPage() );
      delay(2000);
   
   }
   else
   {
      u8g.firstPage();  
      do {
        draw(interrupt_count);
      } while( u8g.nextPage() );
   }
}

long iLastFireTime=0;
int iLastValue= LOW;

void readSensor()
{
    cli();
    
    pinMode(sensorPowerPin, OUTPUT);
    digitalWrite(sensorPowerPin, HIGH); 
    delay(1);
    int iVal= digitalRead(sensorPin);
  
    long time_now= millis();
    if(iVal==HIGH && iVal!=iLastValue)
    {
          wakeUpSystem();
          
          pinMode(tonePin, OUTPUT);     //set the pin to input
          tone(tonePin, 150);
          delay(40);
          pinMode(tonePin, INPUT);     //set the pin to input
         
          wakeup_no_activity_count=0;
          interrupt_count++;
          drawOnDisplay();
    }
  
    iLastValue= iVal;
    sei(); 
    
    sleep();
}

void loop() {
  
    readSensor();
  

  //sleep();
} 
